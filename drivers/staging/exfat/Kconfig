## drivers/staging/exfat/Kconfig
```kconfig
# SPDX-License-Identifier: GPL-2.0
config EXFAT_STAGING
	tristate "exFAT fs support (staging, 5.4 old driver)"
	depends on BLOCK
	select NLS
	default n
	help
	  This is the old staging exFAT driver.  The mainline fs/exfat
	  driver is selected by CONFIG_EXFAT_FS; enable only one of them.

config EXFAT_DONT_MOUNT_VFAT
	bool "Prohibit mounting of fat/vfat filesystems by exFAT (staging)"
	depends on EXFAT_STAGING
	default y
	help
	  By default, the exFAT driver will only mount exFAT filesystems, and refuse
	  to mount fat/vfat filesystems.  Set this to 'n' to allow the exFAT driver
	  to mount these filesystems.

config EXFAT_DISCARD
	bool "enable discard support"
	depends on EXFAT_STAGING
	default y

config EXFAT_DELAYED_SYNC
	bool "enable delayed sync"
	depends on EXFAT_STAGING
	default n

config EXFAT_KERNEL_DEBUG
	bool "enable kernel debug features via ioctl"
	depends on EXFAT_STAGING
	default n

config EXFAT_DEBUG_MSG
	bool "print debug messages"
	depends on EXFAT_STAGING
	default n

config EXFAT_STAGING_DEFAULT_CODEPAGE
	int "Default codepage for exFAT (staging)"
	default 437
	depends on EXFAT_STAGING
	help
	  This option should be set to the codepage of your exFAT filesystems.

config EXFAT_STAGING_DEFAULT_IOCHARSET
	string "Default iocharset for exFAT (staging)"
	default "utf8"
	depends on EXFAT_STAGING
	help
	  Set this to the default input/output character set you'd like exFAT to use.
```

## fs/erofs/Kconfig
```kconfig
# SPDX-License-Identifier: GPL-2.0-only

config EROFS_FS
	tristate "EROFS filesystem support"
	depends on BLOCK
	help
	  EROFS (Enhanced Read-Only File System) is a lightweight
	  read-only file system with modern designs (eg. page-sized
	  blocks, inline xattrs/data, etc.) for scenarios which need
	  high-performance read-only requirements, e.g. Android OS
	  for mobile phones and LIVECDs.

	  It also provides fixed-sized output compression support,
	  which improves storage density, keeps relatively higher
	  compression ratios, which is more useful to achieve high
	  performance for embedded devices with limited memory.

	  If unsure, say N.

config EROFS_FS_DEBUG
	bool "EROFS debugging feature"
	depends on EROFS_FS
	help
	  Print debugging messages and enable more BUG_ONs which check
	  filesystem consistency and find potential issues aggressively,
	  which can be used for Android eng build, for example.

	  For daily use, say N.

config EROFS_FS_XATTR
	bool "EROFS extended attributes"
	depends on EROFS_FS
	default y
	help
	  Extended attributes are name:value pairs associated with inodes by
	  the kernel or by users (see the attr(5) manual page, or visit
	  <http://acl.bestbits.at/> for details).

	  If unsure, say N.

config EROFS_FS_POSIX_ACL
	bool "EROFS Access Control Lists"
	depends on EROFS_FS_XATTR
	select FS_POSIX_ACL
	default y
	help
	  Posix Access Control Lists (ACLs) support permissions for users and
	  groups beyond the owner/group/world scheme.

	  To learn more about Access Control Lists, visit the POSIX ACLs for
	  Linux website <http://acl.bestbits.at/>.

	  If you don't know what Access Control Lists are, say N.

config EROFS_FS_SECURITY
	bool "EROFS Security Labels"
	depends on EROFS_FS_XATTR
	default y
	help
	  Security labels provide an access control facility to support Linux
	  Security Models (LSMs) accepted by AppArmor, SELinux, Smack and TOMOYO
	  Linux. This option enables an extended attribute handler for file
	  security labels in the erofs filesystem, so that it requires enabling
	  the extended attribute support in advance.

	  If you are not using a security module, say N.

config EROFS_FS_ZIP
	bool "EROFS Data Compression Support"
	depends on EROFS_FS
	select LZ4_DECOMPRESS
	default y
	help
	  Enable fixed-sized output compression for EROFS.

	  If you don't want to enable compression feature, say N.

config EROFS_FS_PCPU_KTHREAD
	bool "EROFS per-CPU decompression workers"
	depends on EROFS_FS_ZIP
	help
	  Use a per-CPU kthread pool to decompress physical clusters
	  asynchronously instead of doing it in the caller's context.
	  This improves read latency under memory pressure, at the cost
	  of one extra thread per CPU.

	  Restored from the device kernel (/proc/config.gz of the UMS9157
	  image has it =y together with EROFS_FS_PCPU_KTHREAD_HIPRI; the
	  Image carries the z_erofs_pcpu_workers / z_erofs_pcpu_worker_lock
	  percpu globals).  Source status: see ums9157-recon 8.24.

config EROFS_FS_PCPU_KTHREAD_HIPRI
	bool "EROFS high priority per-CPU decompression workers"
	depends on EROFS_FS_PCPU_KTHREAD
	help
	  Run the per-CPU decompression kthreads at a higher scheduling
	  priority (SCHED_FIFO) so that decompression is not delayed by
	  ordinary CPU hogs.

	  Restored from the device kernel, same origin as the option above.

config EROFS_FS_CLUSTER_PAGE_LIMIT
	int "EROFS Cluster Pages Hard Limit"
	depends on EROFS_FS_ZIP
	range 1 256
	default "1"
	help
	  Indicates maximum # of pages of a compressed
	  physical cluster.

	  For example, if files in a image were compressed
	  into 8k-unit, hard limit should not be configured
	  less than 2. Otherwise, the image will be refused
	  to mount on this kernel.
```
